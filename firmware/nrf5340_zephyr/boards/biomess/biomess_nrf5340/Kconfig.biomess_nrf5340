## firmware/nrf5340_zephyr/boards/biomess/biomess_nrf5340/Kconfig.biomess_nrf5340
```kconfig
# BioMess nRF5340 board configuration

# SPDX-License-Identifier: Apache-2.0

config BOARD_BIOMESS_NRF5340
	select SOC_NRF5340_CPUAPP_QKAA if BOARD_BIOMESS_NRF5340_NRF5340_CPUAPP
	select SOC_NRF5340_CPUAPP_QKAA if BOARD_BIOMESS_NRF5340_NRF5340_CPUAPP_NS
	select SOC_NRF5340_CPUNET_QKAA if BOARD_BIOMESS_NRF5340_NRF5340_CPUNET
```

## firmware/nrf5340_zephyr/boards/biomess/biomess_nrf5340/Kconfig.defconfig
```kconfig
# BioMess nRF5340 board configuration

# SPDX-License-Identifier: Apache-2.0

config HW_STACK_PROTECTION
	default ARCH_HAS_STACK_PROTECTION

if BOARD_BIOMESS_NRF5340_NRF5340_CPUAPP || BOARD_BIOMESS_NRF5340_NRF5340_CPUAPP_NS

if BOARD_BIOMESS_NRF5340_NRF5340_CPUAPP && TRUSTED_EXECUTION_SECURE

DT_CHOSEN_Z_SRAM_PARTITION := zephyr,sram-secure-partition

config SRAM_SIZE
	default $(dt_chosen_reg_size_int,$(DT_CHOSEN_Z_SRAM_PARTITION),0,K)

endif # BOARD_BIOMESS_NRF5340_NRF5340_CPUAPP && TRUSTED_EXECUTION_SECURE

config BOARD_BIOMESS_NRF5340
	select USE_DT_CODE_PARTITION if BOARD_BIOMESS_NRF5340_NRF5340_CPUAPP_NS

config BT_HCI_IPC
	default y if BT_HCI

config HEAP_MEM_POOL_ADD_SIZE_BOARD
	int
	default 4096 if BT_HCI_IPC

endif # BOARD_BIOMESS_NRF5340_NRF5340_CPUAPP || BOARD_BIOMESS_NRF5340_NRF5340_CPUAPP_NS
```

## firmware/nrf5340_zephyr/boards/biomess/biomess_nrf5340/board.yml
```yaml
board:
  name: biomess_nrf5340
  full_name: BioMess nRF5340 PCB
  vendor: biomess
  socs:
  - name: 'nrf5340'
    variants:
    - name: 'ns'
      cpucluster: 'cpuapp'
```
